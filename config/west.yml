## config/west.yml
```yaml
manifest:
  defaults:
    revision: v0.3
  remotes:
    - name: zmkfirmware
      url-base: https://github.com/zmkfirmware
    - name: mctechnology17
      url-base: https://github.com/mctechnology17
    - name: carrefinho
      url-base: https://github.com/carrefinho
    - name: geeksville
      url-base: https://github.com/geeksville
  projects:
    - name: zmk
      remote: zmkfirmware
      import: app/west.yml
    - name: zmk-nice-oled
      remote: mctechnology17
      revision: main
    - name: prospector-zmk-module
      remote: carrefinho
      revision: main
    - name: cirque-input-module
      remote: geeksville
      revision: ba53fe81bad6690c5999b9e0c113988c1246b4d1
  self:
    path: config
```
